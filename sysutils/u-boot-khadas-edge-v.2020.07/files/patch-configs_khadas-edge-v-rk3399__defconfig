## sysutils/u-boot-rock-pi-4/files/patch-configs_rock-pi-4-rk3399__defconfig
```kconfig
--- configs/rock-pi-4-rk3399_defconfig.orig	2020-07-06 22:22:53.000000000 +0300
+++ configs/rock-pi-4-rk3399_defconfig	2021-01-25 09:34:18.620256000 +0300
@@ -2,6 +2,8 @@
 CONFIG_ARCH_ROCKCHIP=y
 CONFIG_SYS_TEXT_BASE=0x00200000
 CONFIG_ENV_OFFSET=0x3F8000
++CONFIG_ENV_SIZE=0x8000
++CONFIG_ENV_SECT_SIZE=0x1000
 CONFIG_ROCKCHIP_RK3399=y
 CONFIG_TARGET_EVB_RK3399=y
 CONFIG_NR_DRAM_BANKS=1
@@ -9,6 +11,7 @@
 CONFIG_DEBUG_UART_CLOCK=24000000
 CONFIG_DEBUG_UART=y
 CONFIG_DEFAULT_FDT_FILE="rockchip/rk3399-rock-pi-4.dtb"
+CONFIG_MISC=y
 CONFIG_MISC_INIT_R=y
 CONFIG_DISPLAY_BOARDINFO_LATE=y
 # CONFIG_SPL_RAW_IMAGE_SUPPORT is not set
@@ -19,15 +22,33 @@
 CONFIG_CMD_GPT=y
 CONFIG_CMD_MMC=y
 CONFIG_CMD_USB=y
+CONFIG_CMD_PCI=y
+CONFIG_CMD_BMP=y
 # CONFIG_CMD_SETEXPR is not set
 CONFIG_CMD_TIME=y
-CONFIG_SPL_OF_CONTROL=y
+CONFIG_SPL_OF_CONTROL=y
+CONFIG_SPL_MTD_SUPPORT=y
+CONFIG_SPL_DM_SEQ_ALIAS=y
+CONFIG_SPL_SPI_LOAD=y
+CONFIG_SPL_SPI_SUPPORT=y
+CONFIG_SPL_SPI_FLASH_SUPPORT=y
+# CONFIG_SPL_TEXT_BASE=0xFF8C2000
+CONFIG_SYS_SPI_U_BOOT_OFFS=0x60000
+CONFIG_SPI_FLASH_XTX=y
+# CONFIG_SF_DEFAULT_BUS=1
+CONFIG_ROCKCHIP_SPI=y
 CONFIG_DEFAULT_DEVICE_TREE="rk3399-rock-pi-4"
 CONFIG_OF_SPL_REMOVE_PROPS="pinctrl-0 pinctrl-names clock-names interrupt-parent assigned-clocks assigned-clock-rates assigned-clock-parents"
-CONFIG_ENV_IS_IN_MMC=y
+# CONFIG_ENV_IS_IN_MMC=y
+CONFIG_ENV_IS_IN_SPI_FLASH=y
+CONFIG_DM_KEYBOARD=y
+CONFIG_USB_KEYBOARD=y
 CONFIG_SYS_RELOC_GD_ENV_ADDR=y
 CONFIG_ROCKCHIP_GPIO=y
 CONFIG_SYS_I2C_ROCKCHIP=y
+CONFIG_ROCKCHIP_EFUSE=y
+CONFIG_PHY_REALTEK=y
+CONFIG_USE_PREBOOT=y
 CONFIG_MMC_DW=y
 CONFIG_MMC_DW_ROCKCHIP=y
 CONFIG_MMC_SDHCI=y
@@ -56,3 +74,11 @@
 CONFIG_USB_ETHER_SMSC95XX=y
 CONFIG_SPL_TINY_MEMSET=y
 CONFIG_ERRNO_STR=y
+CONFIG_DM_RESET=y
+CONFIG_PCI=y
+CONFIG_NVME=y
+CONFIG_DISPLAY=y
+CONFIG_DM_VIDEO=y
+CONFIG_VIDEO_ROCKCHIP=y
+CONFIG_DISPLAY_ROCKCHIP_HDMI=y
+CONFIG_SMBIOS_MANUFACTURER="radxa"
```

## sysutils/u-boot-rock-pi-e/files/patch-configs_rock-pi-e-rk3328__defconfig
```kconfig
--- configs/rock-pi-e-rk3328_defconfig.orig	2020-06-24 15:13:05.120778000 +0300
+++ configs/rock-pi-e-rk3328_defconfig	2020-06-24 15:14:02.584092000 +0300
@@ -102,3 +102,11 @@
 CONFIG_TPL_TINY_MEMSET=y
 CONFIG_ERRNO_STR=y
 CONFIG_SMBIOS_MANUFACTURER="radxa"
+CONFIG_DISPLAY=y
+CONFIG_DM_VIDEO=y
+CONFIG_VIDEO_BPP8=y
+CONFIG_VIDEO_BPP16=y
+CONFIG_VIDEO_BPP32=y
+CONFIG_VIDEO_ROCKCHIP=y
+CONFIG_DISPLAY_ROCKCHIP_HDMI=y
+
```

## sysutils/u-boot-rock-pi-n10/files/patch-configs_rock-pi-n10-rk3399pro__defconfig
```kconfig
--- configs/rock-pi-n10-rk3399pro_defconfig.orig	2020-07-24 16:22:42.436129000 +0300
+++ configs/rock-pi-n10-rk3399pro_defconfig	2020-07-24 16:24:36.655378000 +0300
@@ -48,7 +48,7 @@
 CONFIG_REGULATOR_PWM=y
 CONFIG_REGULATOR_RK8XX=y
 CONFIG_PWM_ROCKCHIP=y
-# CONFIG_RAM_ROCKCHIP_DEBUG is not set
+CONFIG_RAM_ROCKCHIP_DEBUG=y
 CONFIG_DM_RESET=y
 CONFIG_BAUDRATE=1500000
 CONFIG_DEBUG_UART_SHIFT=2
@@ -69,3 +69,6 @@
 CONFIG_VIDEO_ROCKCHIP=y
 CONFIG_DISPLAY_ROCKCHIP_HDMI=y
 CONFIG_ERRNO_STR=y
+CONFIG_SPL_TINY_MEMSET=y
+CONFIG_ROCKCHIP_EFUSE=y
+CONFIG_MMC_VERBOSE=y
```
